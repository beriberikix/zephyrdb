## CMakeLists.txt
```
cmake_minimum_required(VERSION 3.20.0)

set(ZEPHYRDB_LOCAL_MODULE_DIR ${CMAKE_CURRENT_LIST_DIR}/modules/zephyrdb-local)
set(ZEPHYRDB_REPO_MODULE_DIR ${CMAKE_CURRENT_LIST_DIR}/../..)
if(EXISTS ${ZEPHYRDB_LOCAL_MODULE_DIR}/zephyr/module.yml OR
   EXISTS ${ZEPHYRDB_LOCAL_MODULE_DIR}/module.yml)
  list(APPEND EXTRA_ZEPHYR_MODULES ${ZEPHYRDB_LOCAL_MODULE_DIR})
elseif(EXISTS ${ZEPHYRDB_REPO_MODULE_DIR}/zephyr/module.yml OR
       EXISTS ${ZEPHYRDB_REPO_MODULE_DIR}/module.yml)
  list(APPEND EXTRA_ZEPHYR_MODULES ${ZEPHYRDB_REPO_MODULE_DIR})
else()
  message(FATAL_ERROR
    "ts_basic: zephyrdb module not found. Expected module.yml (or zephyr/module.yml) in one of: "
    "${ZEPHYRDB_LOCAL_MODULE_DIR} or ${ZEPHYRDB_REPO_MODULE_DIR}")
endif()

find_package(Zephyr REQUIRED HINTS $ENV{ZEPHYR_BASE})
project(zephyrdb_ts_basic)

target_sources(app PRIVATE src/main.c)
```

## prj.conf
```kconfig
CONFIG_CONSOLE=y
CONFIG_PRINTK=y
CONFIG_HEAP_MEM_POOL_SIZE=4096

CONFIG_ZEPHYRDB=y
CONFIG_ZDB_KV=n
CONFIG_ZDB_TS=y
CONFIG_ZDB_STATS=y
CONFIG_FILE_SYSTEM=y

CONFIG_CRC=y
```

## prj_fcb.conf
```kconfig
CONFIG_CONSOLE=y
CONFIG_PRINTK=y
CONFIG_HEAP_MEM_POOL_SIZE=4096

CONFIG_ZEPHYRDB=y
CONFIG_ZDB_KV=n
CONFIG_ZDB_TS=y
CONFIG_ZDB_TS_BACKEND_FCB=y
CONFIG_ZDB_STATS=y

CONFIG_FCB=y
CONFIG_FLASH=y
CONFIG_FLASH_MAP=y
CONFIG_FLASH_PAGE_LAYOUT=y
CONFIG_CRC=y

# Optional tuning for FCB backend
CONFIG_ZDB_TS_FCB_FLASH_AREA_ID=0
CONFIG_ZDB_TS_FCB_SECTOR_COUNT=4
```

## prj_nrf52840dk.conf
```kconfig
# nrf52840dk board-specific configuration
# This configuration enables real FLASH-backed LittleFS storage for functional testing
#
# Usage: west build -b nrf52840dk samples/ts_basic -- -DOVERLAY_CONFIG=prj_nrf52840dk.conf

CONFIG_CONSOLE=y
CONFIG_PRINTK=y
CONFIG_HEAP_MEM_POOL_SIZE=4096

CONFIG_ZEPHYRDB=y
CONFIG_ZDB_KV=n
CONFIG_ZDB_TS=y
CONFIG_ZDB_STATS=y

CONFIG_CRC=y

# Required for LittleFS functionality on nrf52840dk
# Uncomment when building for hardware; not available on native_sim
# CONFIG_FILE_SYSTEM=y
# CONFIG_FILE_SYSTEM_LITTLEFS=y
# CONFIG_FLASH=y
```

## prj_nrf52840dk_sdcard.conf
```kconfig
# nrf52840dk SD-card overlay (LittleFS BLK mode)
#
# Usage:
#   west build -b nrf52840dk/nrf52840 samples/ts_basic \
#     -- -DOVERLAY_CONFIG=prj_nrf52840dk_sdcard.conf
#
# This overlay targets SD-card backed LittleFS (BLK mode).
# A board DTS overlay is still required to bind the SD-card disk device.

CONFIG_CONSOLE=y
CONFIG_PRINTK=y
CONFIG_HEAP_MEM_POOL_SIZE=4096

CONFIG_ZEPHYRDB=y
CONFIG_ZDB_KV=n
CONFIG_ZDB_TS=y
CONFIG_ZDB_TS_BACKEND_LITTLEFS=y
CONFIG_ZDB_STATS=y

CONFIG_FILE_SYSTEM=y
CONFIG_FILE_SYSTEM_LITTLEFS=y
CONFIG_FS_LITTLEFS_BLK_DEV=y

# Select one SD disk driver path supported by your board wiring.
# Keep SDMMC disabled by default for nrf52840dk unless your HW exposes SDMMC.
CONFIG_DISK_DRIVER_SDMMC=n
# CONFIG_DISK_DRIVER_MMC=y

CONFIG_CRC=y
```

## prj_sdcard.conf
```kconfig
CONFIG_CONSOLE=y
CONFIG_PRINTK=y
CONFIG_HEAP_MEM_POOL_SIZE=4096

CONFIG_ZEPHYRDB=y
CONFIG_ZDB_KV=n
CONFIG_ZDB_TS=y
CONFIG_ZDB_TS_BACKEND_LITTLEFS=y
CONFIG_ZDB_STATS=y

CONFIG_FILE_SYSTEM=y
CONFIG_FILE_SYSTEM_LITTLEFS=y
CONFIG_FS_LITTLEFS_BLK_DEV=y
CONFIG_DISK_DRIVER_SDMMC=y

CONFIG_CRC=y
```

## src/main.c
```c
#include <zephyr/kernel.h>
#include <zephyr/sys/printk.h>

#include "zephyrdb.h"

static const zdb_cfg_t g_cfg = {
    .kv_backend_fs = NULL,
    .lfs_mount_point = CONFIG_ZDB_LFS_MOUNT_POINT,
    .work_q = &k_sys_work_q,
};

ZDB_DEFINE_STATIC(g_db, g_cfg);

int main(void)
{
#if !defined(CONFIG_ZDB_TS) || !(CONFIG_ZDB_TS)
    printk("TS sample: CONFIG_ZDB_TS is disabled for this board/config.\n");
    return 0;
#else
    zdb_status_t rc;
    zdb_ts_t stream;
    zdb_ts_sample_i64_t sample = {
        .ts_ms = (uint64_t)k_uptime_get(),
        .value = 100,
    };
    zdb_ts_agg_result_t agg;
    zdb_ts_window_t window = ZDB_TS_WINDOW_ALL;

    rc = zdb_init(&g_db, &g_cfg);
    if (rc != ZDB_OK) {
        printk("TS sample: zdb_init failed rc=%d\n", (int)rc);
        return 1;
    }

    rc = zdb_ts_open(&g_db, "metrics", &stream);
    if (rc != ZDB_OK) {
        printk("TS sample: zdb_ts_open failed rc=%d (configure/mount filesystem at %s)\n",
               (int)rc, g_cfg.lfs_mount_point);
        (void)zdb_deinit(&g_db);
        return 0;
    }

    rc = zdb_ts_append_i64(&stream, &sample);
    if (rc != ZDB_OK) {
        printk("TS sample: append failed rc=%d\n", (int)rc);
        (void)zdb_ts_close(&stream);
        (void)zdb_deinit(&g_db);
        return 1;
    }

    rc = zdb_ts_flush_sync(&stream, K_SECONDS(2));
    if (rc != ZDB_OK) {
        printk("TS sample: flush failed rc=%d\n", (int)rc);
        (void)zdb_ts_close(&stream);
        (void)zdb_deinit(&g_db);
        return 1;
    }

    rc = zdb_ts_query_aggregate(&stream, window, ZDB_TS_AGG_AVG, &agg);
    if (rc == ZDB_OK) {
        printk("TS sample PASS: avg=%f points=%u\n", agg.value, agg.points);
    } else {
        printk("TS sample: aggregate query returned rc=%d\n", (int)rc);
    }

    (void)zdb_ts_close(&stream);
    (void)zdb_deinit(&g_db);
    return 0;
#endif
}
```
