## tests/integration/workflows_app/testcase.yaml
```yaml
tests:
  zephyrdb.integration.workflows:
    harness: ztest
    tags:
      - zephyrdb
      - integration
      - workflows
    platform_allow:
      - native_sim
```

## tests/integration_smoke/testcase.yaml
```yaml
tests:
  zephyrdb.integration_smoke.core:
    tags:
      - zephyrdb
      - integration
      - smoke
    harness: ztest
    platform_allow:
      - native_sim
```

## tests/samples/verify/testcase.yaml
```yaml
tests:
  zephyrdb.samples.verify:
    harness: ztest
    tags:
      - zephyrdb
      - samples
    platform_allow:
      - native_sim
```

## tests/samples_smoke/testcase.yaml
```yaml
tests:
  zephyrdb.samples_smoke.kv_flow:
    tags:
      - zephyrdb
      - samples
      - smoke
    harness: ztest
    platform_allow:
      - native_sim
```

## tests/unit/doc_basic_app/testcase.yaml
```yaml
tests:
  zephyrdb.unit.doc_basic:
    harness: ztest
    tags:
      - zephyrdb
      - unit
      - doc
    platform_allow:
      - native_sim
```

## tests/unit/kv_basic_app/testcase.yaml
```yaml
tests:
  zephyrdb.unit.kv_basic:
    harness: ztest
    tags:
      - zephyrdb
      - unit
      - kv
    platform_allow:
      - native_sim
```

## tests/unit/ts_basic_app/testcase.yaml
```yaml
tests:
  zephyrdb.unit.ts_basic:
    harness: ztest
    tags:
      - zephyrdb
      - unit
      - ts
    platform_allow:
      - native_sim
```

## tests/unit_kv_events/testcase.yaml
```yaml
tests:
  zephyrdb.unit.kv.events:
    tags:
      - zephyrdb
      - unit
      - kv
      - events
    harness: ztest
    platform_allow:
      - native_sim
```

## tests/unit_kv_hydrate/testcase.yaml
```yaml
tests:
  zephyrdb.unit.kv.hydrate:
    tags:
      - zephyrdb
      - unit
      - kv
      - hydrate
    harness: ztest
    platform_allow:
      - native_sim
```

## tests/unit_kv_smoke/testcase.yaml
```yaml
tests:
  zephyrdb.unit_smoke.kv:
    tags:
      - zephyrdb
      - unit
      - kv
      - smoke
    harness: ztest
    platform_allow:
      - native_sim
```

## tests/unit_smoke/testcase.yaml
```yaml
tests:
  zephyrdb.unit_smoke.core:
    tags:
      - zephyrdb
      - unit
      - smoke
    harness: ztest
    platform_allow:
      - native_sim
```

## tests/unit_ts_smoke/testcase.yaml
```yaml
tests:
  zephyrdb.unit_smoke.ts:
    tags:
      - zephyrdb
      - unit
      - ts
      - smoke
    harness: ztest
    platform_allow:
      - native_sim
```
