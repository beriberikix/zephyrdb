## CMakeLists.txt
```
cmake_minimum_required(VERSION 3.20.0)

# Build as a standalone Zephyr app while consuming ZephyrDB through a local
# module wrapper that points at the repository root Kconfig/CMake.
set(ZEPHYRDB_LOCAL_MODULE_DIR ${CMAKE_CURRENT_LIST_DIR}/modules/zephyrdb-local)
set(ZEPHYRDB_REPO_MODULE_DIR ${CMAKE_CURRENT_LIST_DIR}/../..)
if(EXISTS ${ZEPHYRDB_LOCAL_MODULE_DIR}/zephyr/module.yml OR
   EXISTS ${ZEPHYRDB_LOCAL_MODULE_DIR}/module.yml)
  list(APPEND EXTRA_ZEPHYR_MODULES ${ZEPHYRDB_LOCAL_MODULE_DIR})
elseif(EXISTS ${ZEPHYRDB_REPO_MODULE_DIR}/zephyr/module.yml OR
       EXISTS ${ZEPHYRDB_REPO_MODULE_DIR}/module.yml)
  list(APPEND EXTRA_ZEPHYR_MODULES ${ZEPHYRDB_REPO_MODULE_DIR})
else()
  message(FATAL_ERROR
    "native_sim_harness: zephyrdb module not found. Expected module.yml (or zephyr/module.yml) in one of: "
    "${ZEPHYRDB_LOCAL_MODULE_DIR} or ${ZEPHYRDB_REPO_MODULE_DIR}")
endif()

# Stage 2 path needs flatcc-zephyr overlay module.
# flatcc-zephyr carries a repo-root zephyr/module.yml. Look in the west
# workspace layout (<topdir>/modules/lib/flatcc-zephyr) first, then a
# checkout next to this repo. West workspaces auto-discover the same
# path; registering it again here is harmless and covers standalone use.
set(FLATCC_ZEPHYR_CANDIDATES
    ${CMAKE_CURRENT_LIST_DIR}/../../../../modules/lib/flatcc-zephyr
    ${CMAKE_CURRENT_LIST_DIR}/../../../modules/lib/flatcc-zephyr
    ${CMAKE_CURRENT_LIST_DIR}/../../../flatcc-zephyr)
set(FLATCC_ZEPHYR_MODULE_DIR "")
foreach(candidate ${FLATCC_ZEPHYR_CANDIDATES})
  if(EXISTS ${candidate}/zephyr/module.yml)
    set(FLATCC_ZEPHYR_MODULE_DIR ${candidate})
    break()
  endif()
endforeach()
if(FLATCC_ZEPHYR_MODULE_DIR)
  list(APPEND EXTRA_ZEPHYR_MODULES ${FLATCC_ZEPHYR_MODULE_DIR})
else()
  message(FATAL_ERROR
    "native_sim_harness: flatcc-zephyr module not found. Searched: ${FLATCC_ZEPHYR_CANDIDATES}. "
    "Run 'west update' (flatcc-zephyr is in west.yml) or clone beriberikix/flatcc-zephyr next to zephyrdb.")
endif()

find_package(Zephyr REQUIRED HINTS $ENV{ZEPHYR_BASE})
project(zephyrdb_native_sim_harness)

target_sources(app PRIVATE src/main.c)
target_link_libraries(app PRIVATE flatccrt)
```

## prj.conf
```kconfig
CONFIG_CONSOLE=y
CONFIG_PRINTK=y
CONFIG_HEAP_MEM_POOL_SIZE=4096

# ZephyrDB
CONFIG_ZEPHYRDB=y
CONFIG_ZDB_KV=n
CONFIG_ZDB_STATS=y

# Stage 2 bootstrap path
CONFIG_ZDB_FLATBUFFERS=y

# FlatCC runtime
CONFIG_FLATCC=y
CONFIG_FLATCC_ALLOC_ZEPHYR=y
CONFIG_FLATCC_RUNTIME_JSON=n
CONFIG_FLATCC_RUNTIME_REFMAP=y

# Required by ZDB_TS dependency chain
CONFIG_FILE_SYSTEM=y
```

## src/main.c
```c
#include <zephyr/kernel.h>
#include <zephyr/sys/printk.h>

#include "zephyrdb.h"

static const zdb_cfg_t g_cfg = {
	.kv_backend_fs = NULL,
	.lfs_mount_point = CONFIG_ZDB_LFS_MOUNT_POINT,
	.work_q = &k_sys_work_q,
};

ZDB_DEFINE_STATIC(g_db, g_cfg);

int main(void)
{
	zdb_status_t rc;
	zdb_ts_sample_i64_t sample = {
		.ts_ms = (uint64_t)k_uptime_get(),
		.value = 123,
	};
	size_t fb_len = 0U;
	uint8_t fb_buf[64];
	zdb_ts_stats_t ts_stats;

	rc = zdb_init(&g_db, &g_cfg);
	if (rc != ZDB_OK) {
		printk("FAIL: zdb_init rc=%d\n", (int)rc);
		return 1;
	}

	/* Stage 2 bootstrap: size query + export FlatBuffer payload. */
	rc = zdb_ts_sample_i64_export_flatbuffer(&sample, NULL, 0U, &fb_len);
	if ((rc != ZDB_OK) || (fb_len == 0U) || (fb_len > sizeof(fb_buf))) {
		printk("FAIL: size query rc=%d len=%u\n", (int)rc, (unsigned)fb_len);
		(void)zdb_deinit(&g_db);
		return 1;
	}

	rc = zdb_ts_sample_i64_export_flatbuffer(&sample, fb_buf, sizeof(fb_buf), &fb_len);
	if ((rc != ZDB_OK) || (fb_len == 0U)) {
		printk("FAIL: export rc=%d len=%u\n", (int)rc, (unsigned)fb_len);
		(void)zdb_deinit(&g_db);
		return 1;
	}

	zdb_ts_stats_get(&g_db, &ts_stats);
	printk("PASS: native_sim harness exported %u bytes\n", (unsigned)fb_len);
	ARG_UNUSED(ts_stats);

	(void)zdb_deinit(&g_db);
	return 0;
}
```
