## CMakeLists.txt
```
cmake_minimum_required(VERSION 3.20.0)

set(ZEPHYRDB_LOCAL_MODULE_DIR ${CMAKE_CURRENT_LIST_DIR}/modules/zephyrdb-local)
set(ZEPHYRDB_REPO_MODULE_DIR ${CMAKE_CURRENT_LIST_DIR}/../..)
if(EXISTS ${ZEPHYRDB_LOCAL_MODULE_DIR}/zephyr/module.yml OR
   EXISTS ${ZEPHYRDB_LOCAL_MODULE_DIR}/module.yml)
  list(APPEND EXTRA_ZEPHYR_MODULES ${ZEPHYRDB_LOCAL_MODULE_DIR})
elseif(EXISTS ${ZEPHYRDB_REPO_MODULE_DIR}/zephyr/module.yml OR
       EXISTS ${ZEPHYRDB_REPO_MODULE_DIR}/module.yml)
  list(APPEND EXTRA_ZEPHYR_MODULES ${ZEPHYRDB_REPO_MODULE_DIR})
else()
  message(FATAL_ERROR
    "eventing_zbus: zephyrdb module not found. Expected module.yml (or zephyr/module.yml) in one of: "
    "${ZEPHYRDB_LOCAL_MODULE_DIR} or ${ZEPHYRDB_REPO_MODULE_DIR}")
endif()

# flatcc-zephyr carries a repo-root zephyr/module.yml. Look in the west
# workspace layout (<topdir>/modules/lib/flatcc-zephyr) first, then a
# checkout next to this repo. West workspaces auto-discover the same
# path; registering it again here is harmless and covers standalone use.
set(FLATCC_ZEPHYR_CANDIDATES
    ${CMAKE_CURRENT_LIST_DIR}/../../../../modules/lib/flatcc-zephyr
    ${CMAKE_CURRENT_LIST_DIR}/../../../modules/lib/flatcc-zephyr
    ${CMAKE_CURRENT_LIST_DIR}/../../../flatcc-zephyr)
set(FLATCC_ZEPHYR_MODULE_DIR "")
foreach(candidate ${FLATCC_ZEPHYR_CANDIDATES})
  if(EXISTS ${candidate}/zephyr/module.yml)
    set(FLATCC_ZEPHYR_MODULE_DIR ${candidate})
    break()
  endif()
endforeach()
if(FLATCC_ZEPHYR_MODULE_DIR)
  list(APPEND EXTRA_ZEPHYR_MODULES ${FLATCC_ZEPHYR_MODULE_DIR})
else()
  message(FATAL_ERROR
    "eventing_zbus: flatcc-zephyr module not found. Searched: ${FLATCC_ZEPHYR_CANDIDATES}. "
    "Run 'west update' (flatcc-zephyr is in west.yml) or clone beriberikix/flatcc-zephyr next to zephyrdb.")
endif()

find_package(Zephyr REQUIRED HINTS $ENV{ZEPHYR_BASE})
project(zephyrdb_eventing_zbus)

target_sources(app PRIVATE src/main.c)
```

## sample.yaml
```
sample:
  name: ZephyrDB eventing over zbus sample

common:
  tags:
    - zephyrdb
    - samples
    - eventing
    - zbus
  integration_platforms:
    - native_sim

tests:
  zephyrdb.samples.eventing_zbus:
    harness: console
    harness_config:
      type: multi_line
      regex:
        - "eventing_zbus: event after kv set"
        - "eventing_zbus: event after kv delete"
        - "eventing_zbus: event after ts append"
        - "eventing_zbus: event after ts flush"
        - "eventing_zbus: event after doc save"
        - "eventing_zbus: event after doc delete"
        - "eventing_zbus: PASS"
    platform_allow:
      - native_sim
    timeout: 30
```

## prj.conf
```kconfig
CONFIG_CONSOLE=y
CONFIG_PRINTK=y

CONFIG_FLASH=y
CONFIG_FLASH_MAP=y
CONFIG_FLASH_PAGE_LAYOUT=y
CONFIG_FLASH_SIMULATOR=y

CONFIG_ZEPHYRDB=y
CONFIG_ZDB_KV=y
CONFIG_ZDB_KV_BACKEND_ZMS=y
CONFIG_ZMS=y
CONFIG_NVS=n

# TS and DOC both store through a filesystem. Without LittleFS mounted the
# sample still builds but skips most of what it exists to show, so the board
# overlay supplies an /lfs partition and these select the backend for it.
CONFIG_ZDB_TS=y
CONFIG_ZDB_TS_BACKEND_LITTLEFS=y
CONFIG_ZDB_DOC=y
CONFIG_FILE_SYSTEM=y
CONFIG_FILE_SYSTEM_LITTLEFS=y
CONFIG_FS_LITTLEFS_FMP_DEV=y

CONFIG_ZDB_STATS=y

CONFIG_ZDB_EVENTING=y
CONFIG_ZDB_EVENTING_ZBUS=y
CONFIG_ZBUS=y

CONFIG_CRC=y

CONFIG_HEAP_MEM_POOL_SIZE=32768
```

## src/main.c
```c
#include <zephyr/device.h>
#include <zephyr/drivers/flash.h>
#include <zephyr/kvss/zms.h>
#include <zephyr/kernel.h>
#include <zephyr/storage/flash_map.h>
#include <zephyr/sys/printk.h>

#include <errno.h>

#include "zephyrdb.h"
#include "zephyrdb_eventing_zbus.h"

static struct zms_fs g_zms;

static zdb_cfg_t g_cfg = {
	.kv_backend_fs = NULL,
	.lfs_mount_point = CONFIG_ZDB_LFS_MOUNT_POINT,
	.work_q = &k_sys_work_q,
};

ZDB_DEFINE_STATIC(g_db, g_cfg);

#define ZDB_ZMS_PARTITION storage_partition
#define ZDB_ZMS_PARTITION_DEVICE PARTITION_DEVICE(ZDB_ZMS_PARTITION)
#define ZDB_ZMS_PARTITION_OFFSET PARTITION_OFFSET(ZDB_ZMS_PARTITION)

static const char *kv_event_type_str(zdb_event_type_t type)
{
	switch (type) {
	case ZDB_EVENT_KV_SET:
		return "SET";
	case ZDB_EVENT_KV_DELETE:
		return "DELETE";
	case ZDB_EVENT_KV_INDEX_FULL:
		return "INDEX_FULL";
	default:
		return "UNKNOWN";
	}
}

static const char *core_event_type_str(zdb_core_event_type_t type)
{
	switch (type) {
	case ZDB_CORE_EVENT_INIT:
		return "INIT";
	case ZDB_CORE_EVENT_DEINIT:
		return "DEINIT";
	case ZDB_CORE_EVENT_HEALTH:
		return "HEALTH";
	default:
		return "UNKNOWN";
	}
}

static const char *ts_event_type_str(zdb_ts_event_type_t type)
{
	switch (type) {
	case ZDB_TS_EVENT_APPEND:
		return "APPEND";
	case ZDB_TS_EVENT_FLUSH:
		return "FLUSH";
	case ZDB_TS_EVENT_RECOVER:
		return "RECOVER";
	case ZDB_TS_EVENT_ROLLOVER:
		return "ROLLOVER";
	case ZDB_TS_EVENT_WATERMARK:
		return "WATERMARK";
	default:
		return "UNKNOWN";
	}
}

static const char *doc_event_type_str(zdb_doc_event_type_t type)
{
	switch (type) {
	case ZDB_DOC_EVENT_CREATE:
		return "CREATE";
	case ZDB_DOC_EVENT_SAVE:
		return "SAVE";
	case ZDB_DOC_EVENT_DELETE:
		return "DELETE";
	default:
		return "UNKNOWN";
	}
}

static int init_zms(struct zms_fs *fs)
{
	struct flash_pages_info info;
	int rc;

	fs->flash_device = ZDB_ZMS_PARTITION_DEVICE;
	if (!device_is_ready(fs->flash_device)) {
		printk("eventing_zbus: storage device not ready\n");
		return -ENODEV;
	}

	fs->offset = ZDB_ZMS_PARTITION_OFFSET;
	rc = flash_get_page_info_by_offs(fs->flash_device, fs->offset, &info);
	if (rc != 0) {
		printk("eventing_zbus: flash page info failed rc=%d\n", rc);
		return rc;
	}

	fs->sector_size = info.size;
	fs->sector_count = 3U;

	rc = zms_mount(fs);
	if (rc != 0) {
		printk("eventing_zbus: zms mount failed rc=%d\n", rc);
		return rc;
	}

	return 0;
}

static int print_latest_kv_event(const char *label)
{
	zdb_kv_event_t event;
	int rc;

	rc = zbus_chan_read(&zdb_kv_event_chan, &event, K_NO_WAIT);
	if (rc != 0) {
		printk("eventing_zbus: %s read failed rc=%d\n", label, rc);
		return rc;
	}

	printk("eventing_zbus: %s type=%s ns=%s key=%s len=%u status=%d ts_ms=%llu\n", label,
	       kv_event_type_str(event.type),
	       event.namespace_name,
	       event.key,
	       (unsigned int)event.value_len, (int)event.status,
	       (unsigned long long)event.timestamp_ms);
	return 0;
}

static int print_latest_ts_event(const char *label)
{
	zdb_ts_event_t event;
	int rc;

	rc = zbus_chan_read(&zdb_ts_event_chan, &event, K_NO_WAIT);
	if (rc != 0) {
		printk("eventing_zbus: %s read failed rc=%d\n", label, rc);
		return rc;
	}

	printk("eventing_zbus: %s type=%s stream=%s sample_ts=%llu sample_val=%lld "
	       "flushed=%u truncated=%u status=%d ts_ms=%llu\n",
	       label, ts_event_type_str(event.type),
	       event.stream_name,
	       (unsigned long long)event.sample_ts_ms, (long long)event.sample_value,
	       (unsigned int)event.flushed_bytes, (unsigned int)event.truncated_bytes,
	       (int)event.status, (unsigned long long)event.timestamp_ms);
	return 0;
}

static int print_latest_doc_event(const char *label)
{
	zdb_doc_event_t event;
	int rc;

	rc = zbus_chan_read(&zdb_doc_event_chan, &event, K_NO_WAIT);
	if (rc != 0) {
		printk("eventing_zbus: %s read failed rc=%d\n", label, rc);
		return rc;
	}

	printk("eventing_zbus: %s type=%s collection=%s doc=%s fields=%u bytes=%u status=%d ts_ms=%llu\n",
	       label, doc_event_type_str(event.type),
	       event.collection_name,
	       event.document_id,
	       (unsigned int)event.field_count, (unsigned int)event.serialized_bytes,
	       (int)event.status, (unsigned long long)event.timestamp_ms);
	return 0;
}

static int print_latest_core_event(const char *label)
{
	zdb_core_event_t event;
	int rc;

	rc = zbus_chan_read(&zdb_core_event_chan, &event, K_NO_WAIT);
	if (rc != 0) {
		printk("eventing_zbus: %s read failed rc=%d\n", label, rc);
		return rc;
	}

	printk("eventing_zbus: %s type=%s health=%s prev=%s status=%d ts_ms=%llu\n", label,
	       core_event_type_str(event.type), zdb_health_str(event.health),
	       zdb_health_str(event.prev_health), (int)event.status,
	       (unsigned long long)event.timestamp_ms);
	return 0;
}

int main(void)
{
	zdb_kv_t kv;
	zdb_status_t rc;
	int zms_rc;
	int event_rc;
	uint32_t value = 123U;
	zdb_ts_t ts;
	zdb_ts_sample_i64_t sample = {
		.ts_ms = (uint64_t)k_uptime_get(),
		.value = 77,
	};
	zdb_doc_t doc;

	zms_rc = init_zms(&g_zms);
	if (zms_rc != 0) {
		return 1;
	}

	g_cfg.kv_backend_fs = &g_zms;

	rc = zdb_init(&g_db, &g_cfg);
	if (rc != ZDB_OK) {
		printk("eventing_zbus: zdb_init failed rc=%d\n", (int)rc);
		return 1;
	}

	/* Instance events need no data model — the channel carries them regardless. */
	event_rc = print_latest_core_event("event after init");
	if (event_rc != 0) {
		return 1;
	}

	rc = zdb_kv_open(&g_db, "sample", &kv);
	if (rc != ZDB_OK) {
		printk("eventing_zbus: kv_open failed rc=%d\n", (int)rc);
		return 1;
	}

	rc = zdb_kv_set(&kv, "counter", &value, sizeof(value));
	if (rc != ZDB_OK) {
		printk("eventing_zbus: kv_set failed rc=%d\n", (int)rc);
		return 1;
	}

	event_rc = print_latest_kv_event("event after kv set");
	if (event_rc != 0) {
		return 1;
	}

	rc = zdb_kv_delete(&kv, "counter");
	if (rc != ZDB_OK) {
		printk("eventing_zbus: kv_delete failed rc=%d\n", (int)rc);
		return 1;
	}

	event_rc = print_latest_kv_event("event after kv delete");
	if (event_rc != 0) {
		return 1;
	}

	/*
	 * The board overlay mounts LittleFS at /lfs, so these are expected to
	 * work rather than be skipped — a skip here would mean the sample was
	 * demonstrating nothing.
	 */
	rc = zdb_ts_open(&g_db, "metrics", &ts);
	if (rc != ZDB_OK) {
		printk("eventing_zbus: ts_open failed rc=%d\n", (int)rc);
		return 1;
	}

	rc = zdb_ts_append_i64(&ts, &sample);
	if (rc != ZDB_OK) {
		printk("eventing_zbus: ts_append failed rc=%d\n", (int)rc);
		return 1;
	}
	event_rc = print_latest_ts_event("event after ts append");
	if (event_rc != 0) {
		return 1;
	}

	rc = zdb_ts_flush_sync(&ts, K_SECONDS(2));
	if (rc != ZDB_OK) {
		printk("eventing_zbus: ts_flush failed rc=%d\n", (int)rc);
		return 1;
	}
	event_rc = print_latest_ts_event("event after ts flush");
	if (event_rc != 0) {
		return 1;
	}

	/* A consumer checkpoint is a persistent write, and reports as one. */
	rc = zdb_ts_watermark_set(&ts, sample.ts_ms);
	if (rc != ZDB_OK) {
		printk("eventing_zbus: watermark_set failed rc=%d\n", (int)rc);
		return 1;
	}
	event_rc = print_latest_ts_event("event after ts watermark");
	if (event_rc != 0) {
		return 1;
	}

	(void)zdb_ts_close(&ts);

	rc = zdb_doc_create(&g_db, "users", "u1", &doc);
	if (rc != ZDB_OK) {
		printk("eventing_zbus: doc_create failed rc=%d\n", (int)rc);
		return 1;
	}

	event_rc = print_latest_doc_event("event after doc create");
	if (event_rc != 0) {
		return 1;
	}

	(void)zdb_doc_field_set_string(&doc, "name", "Ada");
	(void)zdb_doc_field_set_bool(&doc, "active", true);

	rc = zdb_doc_save(&doc);
	if (rc != ZDB_OK) {
		printk("eventing_zbus: doc_save failed rc=%d\n", (int)rc);
		return 1;
	}
	event_rc = print_latest_doc_event("event after doc save");
	if (event_rc != 0) {
		return 1;
	}

	rc = zdb_doc_delete(&g_db, "users", "u1");
	if (rc != ZDB_OK) {
		printk("eventing_zbus: doc_delete failed rc=%d\n", (int)rc);
		return 1;
	}
	event_rc = print_latest_doc_event("event after doc delete");
	if (event_rc != 0) {
		return 1;
	}
	(void)zdb_doc_close(&doc);

	(void)zdb_kv_close(&kv);
	(void)zdb_deinit(&g_db);

	event_rc = print_latest_core_event("event after deinit");
	if (event_rc != 0) {
		return 1;
	}

	printk("eventing_zbus: PASS\n");
	return 0;
}
```
