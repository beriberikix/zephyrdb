## Kconfig.zephyrdb
```kconfig
# ZephyrDB Kconfig
# Scope: Core, KV (NVS/ZMS), TS (LittleFS/FCB), DOC (LittleFS),
# eventing (+zbus), stats, shell, and FlatBuffers helpers.
# Every symbol here is consumed by code; planned features live in
# GitHub issues, not in Kconfig.

menuconfig ZEPHYRDB
	bool "ZephyrDB embedded multi-model database"
	depends on FLASH || BOARD_NATIVE_SIM
	help
	  Enable ZephyrDB core services for memory-constrained systems.
	  Provides KV (NVS/ZMS), time-series (LittleFS/FCB), and document
	  (LittleFS) data models.

if ZEPHYRDB

config ZDB_CORE
	bool "Enable ZephyrDB Core"
	default y
	help
	  Enables core engine pieces: storage abstraction hooks,
	  cursor framework, and slab-based pool interfaces.

config ZDB_KV
	bool "Enable ZephyrDB KV module"
	default y
	depends on ZDB_CORE
	help
	  Enables key-value APIs.

choice ZDB_KV_BACKEND
	prompt "KV backend"
	default ZDB_KV_BACKEND_NVS
	depends on ZDB_KV
	help
	  Selects the Zephyr storage backend used by ZephyrDB KV APIs.

config ZDB_KV_BACKEND_NVS
	bool "NVS"
	depends on NVS
	help
	  Use Non-Volatile Storage (NVS) as the KV backend.

config ZDB_KV_BACKEND_ZMS
	bool "ZMS"
	depends on ZMS
	help
	  Use Zephyr Memory Storage (ZMS) as the KV backend.

endchoice

config ZDB_TS
	bool "Enable ZephyrDB Time-Series module"
	default y
	depends on ZDB_CORE && (FILE_SYSTEM || FCB)
	help
	  Enables time-series APIs.

choice ZDB_TS_BACKEND
	prompt "TS backend"
	default ZDB_TS_BACKEND_LITTLEFS
	depends on ZDB_TS
	help
	  Selects the storage backend used by ZephyrDB TS APIs.

config ZDB_TS_BACKEND_LITTLEFS
	bool "LittleFS"
	depends on FILE_SYSTEM
	help
	  Use LittleFS append-log files for time-series storage.

config ZDB_TS_BACKEND_FCB
	bool "FCB"
	depends on FCB
	help
	  Use Flash Circular Buffer (FCB) for time-series storage.

endchoice

menu "Core Boundaries"
	depends on ZDB_CORE

config ZDB_MAX_KEY_LEN
	int "Maximum key length"
	range 8 128
	default 48
	help
	  Upper bound for user-facing keys (excluding trailing NUL).

config ZDB_SCAN_YIELD_EVERY_N
	int "Yield after N scan iterations"
	range 1 4096
	default 64
	help
	  Cooperative scheduling interval for long scans.

config ZDB_CORE_SLAB_BLOCK_SIZE
	int "Core slab block size (bytes)"
	range 32 2048
	default 512 if ZDB_TS_BACKEND_FCB
	default 256
	help
	  Must be large enough to hold the time-series core context. The build
	  asserts this, so a too-small value fails to compile rather than
	  corrupting the slab at runtime. The context holds one slot per
	  concurrently open stream, so raising ZDB_TS_MAX_STREAMS may require
	  raising this too. The FCB backend needs considerably more because the
	  context also embeds the FCB instance and its sector array.

config ZDB_CORE_SLAB_BLOCK_COUNT
	int "Core slab block count"
	range 1 256
	default 16

config ZDB_CURSOR_SLAB_BLOCK_SIZE
	int "Cursor slab block size (bytes)"
	range 32 2048
	default 192
	help
	  Must be large enough to hold a time-series cursor context, which
	  embeds a record-sized staging buffer plus the backend's file or FCB
	  handle. The build asserts this. 64-bit targets need more than 32-bit
	  ones; the default covers both.

config ZDB_CURSOR_SLAB_BLOCK_COUNT
	int "Cursor slab block count"
	range 1 256
	default 8

endmenu

menu "KV Boundaries"
	depends on ZDB_KV

config ZDB_KV_IO_SLAB_BLOCK_SIZE
	int "KV IO slab block size (bytes)"
	range 16 1024
	default 128

config ZDB_KV_IO_SLAB_BLOCK_COUNT
	int "KV IO slab block count"
	range 1 256
	default 8

config ZDB_KV_INDEX_MAX_ENTRIES
	int "Maximum keys tracked by the KV index"
	range 8 1024
	default 128
	help
	  Bounds how many keys the iterator can enumerate. The index costs
	  roughly (2 * (ZDB_MAX_KEY_LEN + 1) + 4) bytes per entry of heap,
	  plus 4 bytes per entry of storage when ZDB_KV_PERSIST_INDEX is
	  enabled. Keys set beyond this bound are stored and readable but
	  are not returned by the iterator.

config ZDB_KV_PERSIST_INDEX
	bool "Persist the KV key index"
	default y
	help
	  Store the key index in a reserved backend record so iteration
	  covers every key across reboots, not just the keys touched in the
	  current session. Rebuilding reads one record per tracked key on
	  first use. Disable to keep iteration session-only and avoid the
	  extra write when a key is created or deleted.

endmenu

menu "TS Boundaries"
	depends on ZDB_TS

config ZDB_TS_STREAM_NAME_MAX_LEN
	int "TS stream name max length"
	range 8 64
	default 24

config ZDB_TS_INGEST_BUFFER_BYTES
	int "TS ingest buffer bytes"
	range 64 16384
	default 1024
	depends on ZDB_TS_BACKEND_LITTLEFS
	help
	  Upper bound for RAM staging prior to sequential flush.

config ZDB_TS_MAX_AGG_POINTS
	int "TS aggregation max points"
	range 1 1048576
	default 4096
	depends on ZDB_TS_BACKEND_LITTLEFS

config ZDB_TS_MAX_STREAMS
	int "Maximum streams open at once"
	range 1 16
	default 1
	help
	  How many time-series streams one instance can hold open
	  simultaneously. Each open stream takes one ingest slab block plus a
	  small slot in the core context, so raising this needs
	  ZDB_TS_INGEST_SLAB_BLOCK_COUNT at least as large, and may need a
	  bigger ZDB_CORE_SLAB_BLOCK_SIZE. The build asserts both.

config ZDB_TS_DELTA_ENCODING
	bool "Store timestamps as deltas to fit more samples"
	default n
	depends on ZDB_TS_BACKEND_LITTLEFS
	help
	  Store each sample's timestamp relative to a base recorded once per
	  segment, and drop the per-record magic and version that the segment
	  header already carries. Records shrink from 28 bytes to 16, so a
	  given amount of storage holds about 1.75x the samples.

	  Records stay fixed size and independently decodable, so reverse
	  cursors and the payload-free COUNT keep working.

	  Streams written without this option are still read, and keep their
	  original format when appended to; only new streams use the compact
	  one. A sample more than 2^32 milliseconds (about 49 days) past its
	  segment's base starts a new segment.

config ZDB_TS_ROLLOVER
	bool "Overwrite the oldest samples when a stream is full"
	default y if ZDB_TS_BACKEND_FCB
	default n
	help
	  Bound a stream's storage: once it reaches capacity, the oldest
	  samples are discarded to make room for new ones, so a long-running
	  logger keeps a recent window instead of filling the partition. With
	  this disabled a full stream reports an error and stops accepting
	  appends, preserving everything already stored.

	  The FCB backend rotates by design, so this defaults on there.

config ZDB_TS_ROLLOVER_SEGMENT_BYTES
	int "Bytes of records per stream segment"
	range 256 1048576
	default 4096
	depends on (ZDB_TS_ROLLOVER || ZDB_TS_DELTA_ENCODING) && ZDB_TS_BACKEND_LITTLEFS
	help
	  Records are grouped into segment files so the oldest can be
	  discarded whole, and so each carries its own timestamp base. This is the record payload per segment, excluding
	  its 16-byte header. Smaller segments discard data in finer steps;
	  larger ones mean fewer files.

config ZDB_TS_ROLLOVER_MAX_SEGMENTS
	int "Segments retained per stream"
	range 2 64
	default 4
	depends on ZDB_TS_ROLLOVER && ZDB_TS_BACKEND_LITTLEFS
	help
	  How many segments a stream keeps. A stream therefore holds roughly
	  ZDB_TS_ROLLOVER_SEGMENT_BYTES times this many bytes of records
	  before the oldest segment is discarded.

config ZDB_TS_INGEST_SLAB_BLOCK_SIZE
	int "TS ingest slab block size (bytes)"
	range 16 2048
	default 64

config ZDB_TS_INGEST_SLAB_BLOCK_COUNT
	int "TS ingest slab block count"
	range 1 512
	default 32

config ZDB_TS_AUTO_RECOVER_ON_OPEN
	bool "Auto recover TS stream on open"
	default y
	depends on ZDB_TS_BACKEND_LITTLEFS
	help
	  If enabled, zdb_ts_open() scans and truncates trailing corrupt or
	  partial records automatically.

config ZDB_TS_MAX_RECOVERY_TRUNCATE_BYTES
	int "Maximum bytes recover may truncate"
	range 0 1048576
	default 4096
	depends on ZDB_TS_BACKEND_LITTLEFS
	help
	  Safety cap for automatic recovery truncation. Set to 0 to disable
	  truncation cap checks.

config ZDB_TS_FCB_FLASH_AREA_ID
	int "TS FCB flash area ID"
	range 0 255
	default 0
	depends on ZDB_TS_BACKEND_FCB
	help
	  Flash area ID passed to fcb_init() for TS backend when using FCB.

config ZDB_TS_FCB_SECTOR_COUNT
	int "TS FCB sector count"
	range 2 64
	default 4
	depends on ZDB_TS_BACKEND_FCB
	help
	  Number of sectors provided to the FCB instance.

endmenu

menu "Storage Integration"

config ZDB_LFS_MOUNT_POINT
	string "LittleFS mount point"
	default "/lfs"
	help
	  Convenience default for applications: pass it as
	  zdb_cfg_t.lfs_mount_point at init. The library never reads this
	  symbol directly; the path must match a filesystem mounted by the
	  application or an fstab automount entry.

config ZDB_TS_DIRNAME
	string "TS stream directory name"
	default "zdb"
	depends on ZDB_TS && ZDB_TS_BACKEND_LITTLEFS
	help
	  Directory under ZDB_LFS_MOUNT_POINT used for time-series stream
	  files. This namespaces ZephyrDB TS files away from other files that
	  may share the same filesystem mount point.

endmenu

menu "Diagnostics"

config ZDB_EVENTING
	bool "Enable ZephyrDB event emitter/listener hooks"
	default n
	depends on ZDB_CORE
	help
	  Enables lightweight local events for key-value, time-series, and
	  document operations, plus instance-level events covering lifecycle
	  and health changes. Mutation events are emitted for whichever
	  modules are enabled; the core events are available even with no
	  data model selected. This feature is intended for in-process
	  listeners and does not provide durability or distributed delivery
	  guarantees.

config ZDB_EVENTING_ZBUS
	bool "Publish events to zbus"
	default n
	depends on ZDB_EVENTING && ZBUS
	help
	  Publishes ZephyrDB events to zbus channels: one per enabled module
	  plus a core channel. This is an optional adapter layer and does not
	  change write-path behavior if publish fails.

config ZDB_STATS
	bool "Enable ZephyrDB statistics counters"
	default n

endmenu

config ZDB_SHELL
	bool "Enable ZephyrDB shell interface"
	depends on SHELL
	help
	  Enables a compact Zephyr shell interface under the 'zdb' command
	  for common development operations.

menu "Stage 2 (Experimental)"

config ZDB_FLATBUFFERS
	bool "Export records and documents as FlatBuffers"
	default n
	depends on (ZDB_TS || ZDB_DOC) && FLATCC
	help
	  Adds helpers that serialize time-series samples and documents into
	  FlatBuffers for sending off-device, leaving stored data in
	  ZephyrDB's own format. Requires the flatcc-zephyr module with
	  CONFIG_FLATCC enabled.

config ZDB_DOC
	bool "Enable document model (Stage 3)"
	default n
	depends on ZDB_CORE && FILE_SYSTEM
	help
	  Enables semi-structured document APIs with typed fields and
	  queries. Documents are stored as individual files on a mounted
	  filesystem (e.g. LittleFS) under the configured mount point.
	  Does not require the TS module.

menu "Document Model (Stage 3)"
	depends on ZDB_DOC

config ZDB_DOC_MAX_FIELD_NAME_LEN
	int "Max document field name length"
	range 8 128
	default 32
	help
	  Maximum length for field names in documents (excluding NUL).

config ZDB_DOC_MAX_STRING_LEN
	int "Max document string field length"
	range 16 65536
	default 256
	help
	  Maximum size of string-type fields within documents.

config ZDB_DOC_MAX_BYTES_LEN
	int "Max document bytes field length"
	range 16 1048576
	default 4096
	help
	  Maximum size of bytes-type fields within documents.

config ZDB_DOC_MAX_FIELD_COUNT
	int "Max fields per document"
	range 1 256
	default 32
	help
	  Upper bound for number of fields in a single document.

endmenu

endmenu

endif # ZEPHYRDB
```

## tests/hardware/persistence_nrf52840dk/testcase.yaml
```yaml
tests:
  zephyrdb.hardware.persistence:
    build_only: true
    harness: ztest
    tags:
      - zephyrdb
      - hardware
    platform_allow:
      - nrf52840dk/nrf52840
```

## tests/integration/workflows/testcase.yaml
```yaml
tests:
  zephyrdb.integration.workflows:
    harness: ztest
    tags:
      - zephyrdb
      - integration
    platform_allow:
      - native_sim
```

## tests/unit/core_events/testcase.yaml
```yaml
tests:
  zephyrdb.unit.core_events:
    harness: ztest
    tags:
      - zephyrdb
      - unit
      - core
      - eventing
    platform_allow:
      - native_sim
```

## tests/unit/doc_events/testcase.yaml
```yaml
tests:
  zephyrdb.unit.doc_events:
    harness: ztest
    tags:
      - zephyrdb
      - unit
      - doc
      - eventing
    platform_allow:
      - native_sim
```

## tests/unit/eventing_zbus/testcase.yaml
```yaml
tests:
  zephyrdb.unit.eventing_zbus:
    harness: ztest
    tags:
      - zephyrdb
      - unit
      - eventing
      - zbus
    platform_allow:
      - native_sim
```

## tests/unit/kv_defaults/testcase.yaml
```yaml
tests:
  zephyrdb.unit.kv.defaults:
    harness: ztest
    tags:
      - zephyrdb
      - unit
      - kv
    platform_allow:
      - native_sim
```

## tests/unit/kv_events/testcase.yaml
```yaml
tests:
  zephyrdb.unit.kv.events:
    harness: ztest
    tags:
      - zephyrdb
      - unit
      - kv
      - eventing
    platform_allow:
      - native_sim
```

## tests/unit/kv_nvs/testcase.yaml
```yaml
tests:
  zephyrdb.unit.kv.nvs:
    harness: ztest
    tags:
      - zephyrdb
      - unit
      - kv
    platform_allow:
      - native_sim
```

## tests/unit/kv_zms/testcase.yaml
```yaml
tests:
  zephyrdb.unit.kv.zms:
    harness: ztest
    tags:
      - zephyrdb
      - unit
      - kv
    platform_allow:
      - native_sim
```

## tests/unit/shell/testcase.yaml
```yaml
tests:
  zephyrdb.unit.shell:
    harness: ztest
    tags:
      - zephyrdb
      - unit
      - shell
    platform_allow:
      - native_sim
```

## tests/unit/ts_agg/testcase.yaml
```yaml
tests:
  zephyrdb.unit.ts_agg:
    harness: ztest
    tags:
      - zephyrdb
      - unit
      - ts
    platform_allow:
      - native_sim
```

## tests/unit/ts_delta/testcase.yaml
```yaml
tests:
  zephyrdb.unit.ts_delta:
    harness: ztest
    tags:
      - zephyrdb
      - unit
      - ts
    platform_allow:
      - native_sim
```

## tests/unit/ts_multistream/testcase.yaml
```yaml
tests:
  zephyrdb.unit.ts_multistream:
    harness: ztest
    tags:
      - zephyrdb
      - unit
      - ts
    platform_allow:
      - native_sim
```

## tests/unit/ts_rollover/testcase.yaml
```yaml
tests:
  zephyrdb.unit.ts_rollover:
    harness: ztest
    tags:
      - zephyrdb
      - unit
      - ts
    platform_allow:
      - native_sim
```
