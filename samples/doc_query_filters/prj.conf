## CMakeLists.txt
```
cmake_minimum_required(VERSION 3.20.0)

set(ZEPHYRDB_LOCAL_MODULE_DIR ${CMAKE_CURRENT_LIST_DIR}/modules/zephyrdb-local)
set(ZEPHYRDB_REPO_MODULE_DIR ${CMAKE_CURRENT_LIST_DIR}/../..)
if(EXISTS ${ZEPHYRDB_LOCAL_MODULE_DIR}/zephyr/module.yml OR
   EXISTS ${ZEPHYRDB_LOCAL_MODULE_DIR}/module.yml)
  list(APPEND EXTRA_ZEPHYR_MODULES ${ZEPHYRDB_LOCAL_MODULE_DIR})
elseif(EXISTS ${ZEPHYRDB_REPO_MODULE_DIR}/zephyr/module.yml OR
       EXISTS ${ZEPHYRDB_REPO_MODULE_DIR}/module.yml)
  list(APPEND EXTRA_ZEPHYR_MODULES ${ZEPHYRDB_REPO_MODULE_DIR})
else()
  message(FATAL_ERROR
    "doc_query_filters: zephyrdb module not found. Expected module.yml (or zephyr/module.yml) in one of: "
    "${ZEPHYRDB_LOCAL_MODULE_DIR} or ${ZEPHYRDB_REPO_MODULE_DIR}")
endif()

# flatcc-zephyr carries a repo-root zephyr/module.yml. Look in the west
# workspace layout (<topdir>/modules/lib/flatcc-zephyr) first, then a
# checkout next to this repo. West workspaces auto-discover the same
# path; registering it again here is harmless and covers standalone use.
set(FLATCC_ZEPHYR_CANDIDATES
    ${CMAKE_CURRENT_LIST_DIR}/../../../../modules/lib/flatcc-zephyr
    ${CMAKE_CURRENT_LIST_DIR}/../../../modules/lib/flatcc-zephyr
    ${CMAKE_CURRENT_LIST_DIR}/../../../flatcc-zephyr)
set(FLATCC_ZEPHYR_MODULE_DIR "")
foreach(candidate ${FLATCC_ZEPHYR_CANDIDATES})
  if(EXISTS ${candidate}/zephyr/module.yml)
    set(FLATCC_ZEPHYR_MODULE_DIR ${candidate})
    break()
  endif()
endforeach()
if(FLATCC_ZEPHYR_MODULE_DIR)
  list(APPEND EXTRA_ZEPHYR_MODULES ${FLATCC_ZEPHYR_MODULE_DIR})
else()
  message(FATAL_ERROR
    "doc_query_filters: flatcc-zephyr module not found. Searched: ${FLATCC_ZEPHYR_CANDIDATES}. "
    "Run 'west update' (flatcc-zephyr is in west.yml) or clone beriberikix/flatcc-zephyr next to zephyrdb.")
endif()

find_package(Zephyr REQUIRED HINTS $ENV{ZEPHYR_BASE})
project(zephyrdb_doc_query_filters)

target_sources(app PRIVATE src/main.c)
target_link_libraries(app PRIVATE flatccrt)
```

## prj.conf
```kconfig
CONFIG_CONSOLE=y
CONFIG_PRINTK=y
CONFIG_HEAP_MEM_POOL_SIZE=8192

CONFIG_ZEPHYRDB=y
CONFIG_ZDB_KV=n
CONFIG_ZDB_TS=y
CONFIG_ZDB_FLATBUFFERS=y
CONFIG_ZDB_DOC=y
CONFIG_ZDB_STATS=y

CONFIG_FILE_SYSTEM=y

CONFIG_FLATCC=y
CONFIG_FLATCC_ALLOC_ZEPHYR=y
CONFIG_FLATCC_RUNTIME_JSON=n
CONFIG_FLATCC_RUNTIME_REFMAP=y

CONFIG_CRC=y
```

## src/main.c
```c
#include <zephyr/kernel.h>
#include <zephyr/sys/printk.h>

#include "zephyrdb.h"

static const zdb_cfg_t g_cfg = {
    .kv_backend_fs = NULL,
    .lfs_mount_point = CONFIG_ZDB_LFS_MOUNT_POINT,
    .work_q = &k_sys_work_q,
};

ZDB_DEFINE_STATIC(g_db, g_cfg);

int main(void)
{
#if !defined(CONFIG_ZDB_DOC) || !(CONFIG_ZDB_DOC)
    printk("DOC query helper: CONFIG_ZDB_DOC is disabled for this board/config.\n");
    return 0;
#else
    zdb_status_t rc;
    zdb_doc_t doc;
    zdb_doc_query_filter_t filters[2];
    zdb_doc_query_t query;
    zdb_doc_metadata_t results[8];
    size_t result_count = ARRAY_SIZE(results);

    rc = zdb_init(&g_db, &g_cfg);
    if (rc != ZDB_OK) {
        printk("DOC query helper: init failed rc=%d\n", (int)rc);
        return 1;
    }

    /* Seed one document for query demonstration. */
    rc = zdb_doc_create(&g_db, "users", "u100", &doc);
    if (rc == ZDB_OK) {
        (void)zdb_doc_field_set_string(&doc, "name", "Ada");
        (void)zdb_doc_field_set_bool(&doc, "active", true);
        rc = zdb_doc_save(&doc);
        (void)zdb_doc_close(&doc);
        if (rc != ZDB_OK) {
            printk("DOC query helper: save failed rc=%d\n", (int)rc);
            printk("DOC query helper: ensure the filesystem is mounted/configured at %s\n",
                   CONFIG_ZDB_LFS_MOUNT_POINT);
            (void)zdb_deinit(&g_db);
            return 1;
        }
    } else {
        printk("DOC query helper: seed create failed rc=%d\n", (int)rc);
        (void)zdb_deinit(&g_db);
        return 1;
    }

    filters[0].field_name = "name";
    filters[0].type = ZDB_DOC_FIELD_STRING;
    filters[0].string_value = "Ada";
    filters[0].numeric_value = 0.0;

    filters[1].field_name = "active";
    filters[1].type = ZDB_DOC_FIELD_BOOL;
    filters[1].bool_value = true;
    filters[1].string_value = NULL;

    query.filters = filters;
    query.filter_count = ARRAY_SIZE(filters);
    query.from_ms = 0U;
    query.to_ms = UINT64_MAX;
    query.limit = (uint32_t)ARRAY_SIZE(results);

    rc = zdb_doc_query(&g_db, &query, results, &result_count);
    if (rc == ZDB_OK) {
        if (result_count > 0U) {
            printk("DOC query helper PASS: matched=%u\n", (unsigned)result_count);
            zdb_doc_metadata_free(results, result_count);
        } else {
            printk("DOC query helper: query returned 0 matches; document storage may be empty or unavailable\n");
        }
    } else {
        printk("DOC query helper: query rc=%d\n", (int)rc);
    }

    (void)zdb_deinit(&g_db);
    return 0;
#endif
}
```
